## buildroot/Config.in
```kconfig
source "$BR2_EXTERNAL_BOOMPI_PATH/package/boompid/Config.in"
source "$BR2_EXTERNAL_BOOMPI_PATH/package/boompi-ui/Config.in"
source "$BR2_EXTERNAL_BOOMPI_PATH/package/retroarch/Config.in"
source "$BR2_EXTERNAL_BOOMPI_PATH/package/retroarch-joypad-autoconfig/Config.in"
source "$BR2_EXTERNAL_BOOMPI_PATH/package/libretro-cores/Config.in"
source "$BR2_EXTERNAL_BOOMPI_PATH/package/libretro-fceumm/Config.in"
source "$BR2_EXTERNAL_BOOMPI_PATH/package/libretro-snes9x/Config.in"
source "$BR2_EXTERNAL_BOOMPI_PATH/package/libretro-gambatte/Config.in"
source "$BR2_EXTERNAL_BOOMPI_PATH/package/libretro-mgba/Config.in"
source "$BR2_EXTERNAL_BOOMPI_PATH/package/libretro-pcsx-rearmed/Config.in"
source "$BR2_EXTERNAL_BOOMPI_PATH/package/libretro-mupen64plus-next/Config.in"
source "$BR2_EXTERNAL_BOOMPI_PATH/package/libretro-mupen64plus-next-pi4/Config.in"
```

## buildroot/package/boompi-ui/Config.in
```kconfig
config BR2_PACKAGE_BOOMPI_UI
	bool "boompi-ui"
	depends on BR2_PACKAGE_HOST_RUSTC_TARGET_ARCH_SUPPORTS
	select BR2_PACKAGE_HOST_RUSTC
	help
	  Boompi v2 touchscreen UI (Slint), rendering directly on DRM/KMS
	  with libinput touch input via Slint's linuxkms backend.

	  https://github.com/TooTallNate/boompi
```

## buildroot/package/boompid/Config.in
```kconfig
config BR2_PACKAGE_BOOMPID
	bool "boompid"
	depends on BR2_PACKAGE_HOST_RUSTC_TARGET_ARCH_SUPPORTS
	select BR2_PACKAGE_HOST_RUSTC
	help
	  Boompi v2 backend daemon: bridges BlueZ, librespot,
	  shairport-sync, PipeWire, and the INA260 battery monitor to UI
	  clients over WebSocket/HTTP.

	  https://github.com/TooTallNate/boompi
```

## buildroot/package/libretro-cores/Config.in
```kconfig
config BR2_PACKAGE_LIBRETRO_CORES
	bool "libretro-cores"
	depends on BR2_PACKAGE_RETROARCH
	select BR2_PACKAGE_LIBRETRO_FCEUMM
	select BR2_PACKAGE_LIBRETRO_SNES9X
	select BR2_PACKAGE_LIBRETRO_GAMBATTE
	select BR2_PACKAGE_LIBRETRO_MGBA
	select BR2_PACKAGE_LIBRETRO_PCSX_REARMED
	select BR2_PACKAGE_LIBRETRO_MUPEN64PLUS_NEXT
	select BR2_PACKAGE_LIBRETRO_MUPEN64PLUS_NEXT_PI4
	help
	  The libretro cores boompi ships: fceumm (NES), snes9x (SNES),
	  gambatte (GB/GBC), mgba (GBA), pcsx_rearmed (PSX, NEON/ari64
	  dynarec), mupen64plus-next (N64, GLES). /usr/lib/libretro/.
```

## buildroot/package/libretro-fceumm/Config.in
```kconfig
config BR2_PACKAGE_LIBRETRO_FCEUMM
	bool "libretro-fceumm"
	help
	  libretro core (libretro-fceumm).
```

## buildroot/package/libretro-gambatte/Config.in
```kconfig
config BR2_PACKAGE_LIBRETRO_GAMBATTE
	bool "libretro-gambatte"
	help
	  libretro core (gambatte-libretro).
```

## buildroot/package/libretro-mgba/Config.in
```kconfig
config BR2_PACKAGE_LIBRETRO_MGBA
	bool "libretro-mgba"
	help
	  libretro core (mgba).
```

## buildroot/package/libretro-mupen64plus-next-pi4/Config.in
```kconfig
config BR2_PACKAGE_LIBRETRO_MUPEN64PLUS_NEXT_PI4
	bool "libretro-mupen64plus-next-pi4"
	help
	  Pi 4 (BCM2711/Cortex-A72) build of the mupen64plus-next core.
	  The rpi3_64 build runs on the Pi 3 but its dynarec segfaults
	  on the A72; Batocera builds per-board (platform=rpi4_64,
	  GLES3) and so do we. boompid's launcher picks this variant on
	  Pi 4 hardware.
```

## buildroot/package/libretro-mupen64plus-next/Config.in
```kconfig
config BR2_PACKAGE_LIBRETRO_MUPEN64PLUS_NEXT
	bool "libretro-mupen64plus-next"
	help
	  libretro core (mupen64plus-libretro-nx).
```

## buildroot/package/libretro-pcsx-rearmed/Config.in
```kconfig
config BR2_PACKAGE_LIBRETRO_PCSX_REARMED
	bool "libretro-pcsx-rearmed"
	help
	  libretro core (pcsx_rearmed).
```

## buildroot/package/libretro-snes9x/Config.in
```kconfig
config BR2_PACKAGE_LIBRETRO_SNES9X
	bool "libretro-snes9x"
	help
	  libretro core (snes9x).
```

## buildroot/package/retroarch-joypad-autoconfig/Config.in
```kconfig
config BR2_PACKAGE_RETROARCH_JOYPAD_AUTOCONFIG
	bool "retroarch-joypad-autoconfig"
	help
	  Joypad autoconfig profiles for RetroArch's udev driver.
	  Without these a connected gamepad is detected but no buttons
	  are mapped to the retropad - the pad appears completely dead
	  in-game.

	  https://github.com/libretro/retroarch-joypad-autoconfig
```

## buildroot/package/retroarch/Config.in
```kconfig
config BR2_PACKAGE_RETROARCH
	bool "retroarch"
	depends on BR2_PACKAGE_MESA3D_OPENGL_EGL # KMS/GBM + GLES
	select BR2_PACKAGE_LIBDRM
	select BR2_PACKAGE_ALSA_LIB
	select BR2_PACKAGE_ZLIB
	select BR2_PACKAGE_FREETYPE
	help
	  RetroArch libretro frontend, built for KMS/GBM + GLES2 with
	  udev input (no X11/Wayland). Cores are separate packages
	  (libretro-cores).

	  https://www.retroarch.com
```
